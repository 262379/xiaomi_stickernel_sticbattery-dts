/* Copyright (c) 2018-2020, The Linux Foundation. All rights reserved.
 * Copyright (C) 2020 Amktiao.
 *
 * This program is free software; you can redistribute it and/or modify
 * it under the terms of the GNU General Public License version 2 and
 * only version 2 as published by the Free Software Foundation.
 *
 * This program is distributed in the hope that it will be useful,
 * but WITHOUT ANY WARRANTY; without even the implied warranty of
 * MERCHANTABILITY or FITNESS FOR A PARTICULAR PURPOSE.  See the
 * GNU General Public License for more details.
 */

qcom,stic_4000mah {
	/* SticBattery Xiaomi SDM845 2020 by Amktiao*/
	qcom,max-voltage-uv = <4430000>;
	qcom,fastchg-current-ma = <6000>;
	qcom,nom-batt-capacity-mah = <4000>;
	qcom,fg-cc-cv-threshold-mv = <4430>;
	qcom,batt-id-kohm = <80>;
	qcom,battery-beta = <3460>;
	qcom,battery-type = "stic_4000mah";
	qcom,jeita-fcc-ranges = <0   50   330000
			51  100  990000
			101  150  990000
			151 650  6000000
			651 700  1350000>;
	qcom,jeita-fv-ranges =  <0   50   6000000
			51  100  6000000
			101  150  6000000
			151 650  6000000
			651 700  2000000>;
	qcom,dynamic-fv-ranges = <0    100  4400000
			101  200  4380000
			201  300  4360000
			301  600  4400000
			601  650  4380000>;
	qcom,checksum = <0x3D0A>;
	qcom,gui-version = "PMI8998GUI - 2.0.0.58";
	qcom,fg-profile-data = [
		 64 1F B8 05
		 3C EB 54 E4
		 3F 18 FF 22
		 41 13 70 1D
		 1E 18 1E 23
		 92 45 88 52
		 52 00 00 00
		 55 00 00 00
		 0E 00 00 00
		 FD D4 68 C3
		 23 00 08 00
		 CA F3 82 3A
		 2A 09 40 40
		 84 05 BE 13
		 18 07 9E 2B
		 21 06 09 20
		 27 00 14 00
		 B7 1F A2 05
		 8E 0A 1C 06
		 7F 1D D9 ED
		 20 12 FE 1D
		 F4 18 0A 23
		 4C 45 49 53
		 54 00 00 00
		 0E 00 00 00
		 00 00 F8 07
		 03 00 27 B2
		 1A 00 00 00
		 FE E2 52 DC
		 85 03 35 F4
		 4D 1D 37 F2
		 23 0A 79 15
		 B7 18 32 23
		 26 45 72 53
		 F0 0E 66 46
		 1A 00 40 00
		 A7 01 0A FA
		 0D 00 00 00
		 00 00 13 CC
		 03 00 98 BD
		 FF 00 00 00
		 00 00 00 00
		 00 00 00 00
		 00 00 00 00
		 00 00 00 00
		 00 00 00 00
		 00 00 00 00
		 00 00 00 00
	];
};